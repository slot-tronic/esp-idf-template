## sdkconfig.defaults
```kconfig
###########################################################################
# Espressif IoT Development Framework (ESP-IDF) Project Configuration
#
# This configuration file overrides sdkconfig settings for ESP32-PICO-D4
#
###########################################################################


###########################################################################
# Flash memory frequency configuration for ESP32-PICO-D4 (works with 80MHz)

CONFIG_ESPTOOLPY_FLASHFREQ_80M=y
# CONFIG_ESPTOOLPY_FLASHFREQ_40M is not set
CONFIG_ESPTOOLPY_FLASHFREQ="80m"


###########################################################################
# Flash size configuration for ESP32-PICO-D4 (has 4MB built-in)

# CONFIG_ESPTOOLPY_FLASHSIZE_2MB is not set
CONFIG_ESPTOOLPY_FLASHSIZE_4MB=y
CONFIG_ESPTOOLPY_FLASHSIZE="4MB"


###########################################################################
# CPU frequency configuration for ESP32-PICO-D4 (Works at 240MHz)

# CONFIG_ESP32_DEFAULT_CPU_FREQ_160 is not set
CONFIG_ESP32_DEFAULT_CPU_FREQ_240=y
CONFIG_ESP32_DEFAULT_CPU_FREQ_MHZ=240
```
